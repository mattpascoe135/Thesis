    IF :LNOT::DEF:INCLUDED_CYFITTERRV_INC
INCLUDED_CYFITTERRV_INC EQU 1
    GET cydevicerv_trm.inc

; Rx
Rx__0__DR EQU CYREG_GPIO_PRT3_DR
Rx__0__DR_CLR EQU CYREG_GPIO_PRT3_DR_CLR
Rx__0__DR_INV EQU CYREG_GPIO_PRT3_DR_INV
Rx__0__DR_SET EQU CYREG_GPIO_PRT3_DR_SET
Rx__0__HSIOM EQU CYREG_HSIOM_PORT_SEL3
Rx__0__HSIOM_MASK EQU 0x000000F0
Rx__0__HSIOM_SHIFT EQU 4
Rx__0__INTCFG EQU CYREG_GPIO_PRT3_INTR_CFG
Rx__0__INTR EQU CYREG_GPIO_PRT3_INTR
Rx__0__INTR_CFG EQU CYREG_GPIO_PRT3_INTR_CFG
Rx__0__INTSTAT EQU CYREG_GPIO_PRT3_INTR
Rx__0__MASK EQU 0x02
Rx__0__PA__CFG0 EQU CYREG_UDB_PA3_CFG0
Rx__0__PA__CFG1 EQU CYREG_UDB_PA3_CFG1
Rx__0__PA__CFG10 EQU CYREG_UDB_PA3_CFG10
Rx__0__PA__CFG11 EQU CYREG_UDB_PA3_CFG11
Rx__0__PA__CFG12 EQU CYREG_UDB_PA3_CFG12
Rx__0__PA__CFG13 EQU CYREG_UDB_PA3_CFG13
Rx__0__PA__CFG14 EQU CYREG_UDB_PA3_CFG14
Rx__0__PA__CFG2 EQU CYREG_UDB_PA3_CFG2
Rx__0__PA__CFG3 EQU CYREG_UDB_PA3_CFG3
Rx__0__PA__CFG4 EQU CYREG_UDB_PA3_CFG4
Rx__0__PA__CFG5 EQU CYREG_UDB_PA3_CFG5
Rx__0__PA__CFG6 EQU CYREG_UDB_PA3_CFG6
Rx__0__PA__CFG7 EQU CYREG_UDB_PA3_CFG7
Rx__0__PA__CFG8 EQU CYREG_UDB_PA3_CFG8
Rx__0__PA__CFG9 EQU CYREG_UDB_PA3_CFG9
Rx__0__PC EQU CYREG_GPIO_PRT3_PC
Rx__0__PC2 EQU CYREG_GPIO_PRT3_PC2
Rx__0__PORT EQU 3
Rx__0__PS EQU CYREG_GPIO_PRT3_PS
Rx__0__SHIFT EQU 1
Rx__DR EQU CYREG_GPIO_PRT3_DR
Rx__DR_CLR EQU CYREG_GPIO_PRT3_DR_CLR
Rx__DR_INV EQU CYREG_GPIO_PRT3_DR_INV
Rx__DR_SET EQU CYREG_GPIO_PRT3_DR_SET
Rx__INTCFG EQU CYREG_GPIO_PRT3_INTR_CFG
Rx__INTR EQU CYREG_GPIO_PRT3_INTR
Rx__INTR_CFG EQU CYREG_GPIO_PRT3_INTR_CFG
Rx__INTSTAT EQU CYREG_GPIO_PRT3_INTR
Rx__MASK EQU 0x02
Rx__PA__CFG0 EQU CYREG_UDB_PA3_CFG0
Rx__PA__CFG1 EQU CYREG_UDB_PA3_CFG1
Rx__PA__CFG10 EQU CYREG_UDB_PA3_CFG10
Rx__PA__CFG11 EQU CYREG_UDB_PA3_CFG11
Rx__PA__CFG12 EQU CYREG_UDB_PA3_CFG12
Rx__PA__CFG13 EQU CYREG_UDB_PA3_CFG13
Rx__PA__CFG14 EQU CYREG_UDB_PA3_CFG14
Rx__PA__CFG2 EQU CYREG_UDB_PA3_CFG2
Rx__PA__CFG3 EQU CYREG_UDB_PA3_CFG3
Rx__PA__CFG4 EQU CYREG_UDB_PA3_CFG4
Rx__PA__CFG5 EQU CYREG_UDB_PA3_CFG5
Rx__PA__CFG6 EQU CYREG_UDB_PA3_CFG6
Rx__PA__CFG7 EQU CYREG_UDB_PA3_CFG7
Rx__PA__CFG8 EQU CYREG_UDB_PA3_CFG8
Rx__PA__CFG9 EQU CYREG_UDB_PA3_CFG9
Rx__PC EQU CYREG_GPIO_PRT3_PC
Rx__PC2 EQU CYREG_GPIO_PRT3_PC2
Rx__PORT EQU 3
Rx__PS EQU CYREG_GPIO_PRT3_PS
Rx__SHIFT EQU 1

; Tx
Tx__0__DR EQU CYREG_GPIO_PRT3_DR
Tx__0__DR_CLR EQU CYREG_GPIO_PRT3_DR_CLR
Tx__0__DR_INV EQU CYREG_GPIO_PRT3_DR_INV
Tx__0__DR_SET EQU CYREG_GPIO_PRT3_DR_SET
Tx__0__HSIOM EQU CYREG_HSIOM_PORT_SEL3
Tx__0__HSIOM_MASK EQU 0x0000000F
Tx__0__HSIOM_SHIFT EQU 0
Tx__0__INTCFG EQU CYREG_GPIO_PRT3_INTR_CFG
Tx__0__INTR EQU CYREG_GPIO_PRT3_INTR
Tx__0__INTR_CFG EQU CYREG_GPIO_PRT3_INTR_CFG
Tx__0__INTSTAT EQU CYREG_GPIO_PRT3_INTR
Tx__0__MASK EQU 0x01
Tx__0__OUT_SEL EQU CYREG_UDB_PA3_CFG10
Tx__0__OUT_SEL_SHIFT EQU 0
Tx__0__OUT_SEL_VAL EQU 1
Tx__0__PA__CFG0 EQU CYREG_UDB_PA3_CFG0
Tx__0__PA__CFG1 EQU CYREG_UDB_PA3_CFG1
Tx__0__PA__CFG10 EQU CYREG_UDB_PA3_CFG10
Tx__0__PA__CFG11 EQU CYREG_UDB_PA3_CFG11
Tx__0__PA__CFG12 EQU CYREG_UDB_PA3_CFG12
Tx__0__PA__CFG13 EQU CYREG_UDB_PA3_CFG13
Tx__0__PA__CFG14 EQU CYREG_UDB_PA3_CFG14
Tx__0__PA__CFG2 EQU CYREG_UDB_PA3_CFG2
Tx__0__PA__CFG3 EQU CYREG_UDB_PA3_CFG3
Tx__0__PA__CFG4 EQU CYREG_UDB_PA3_CFG4
Tx__0__PA__CFG5 EQU CYREG_UDB_PA3_CFG5
Tx__0__PA__CFG6 EQU CYREG_UDB_PA3_CFG6
Tx__0__PA__CFG7 EQU CYREG_UDB_PA3_CFG7
Tx__0__PA__CFG8 EQU CYREG_UDB_PA3_CFG8
Tx__0__PA__CFG9 EQU CYREG_UDB_PA3_CFG9
Tx__0__PC EQU CYREG_GPIO_PRT3_PC
Tx__0__PC2 EQU CYREG_GPIO_PRT3_PC2
Tx__0__PORT EQU 3
Tx__0__PS EQU CYREG_GPIO_PRT3_PS
Tx__0__SHIFT EQU 0
Tx__DR EQU CYREG_GPIO_PRT3_DR
Tx__DR_CLR EQU CYREG_GPIO_PRT3_DR_CLR
Tx__DR_INV EQU CYREG_GPIO_PRT3_DR_INV
Tx__DR_SET EQU CYREG_GPIO_PRT3_DR_SET
Tx__INTCFG EQU CYREG_GPIO_PRT3_INTR_CFG
Tx__INTR EQU CYREG_GPIO_PRT3_INTR
Tx__INTR_CFG EQU CYREG_GPIO_PRT3_INTR_CFG
Tx__INTSTAT EQU CYREG_GPIO_PRT3_INTR
Tx__MASK EQU 0x01
Tx__PA__CFG0 EQU CYREG_UDB_PA3_CFG0
Tx__PA__CFG1 EQU CYREG_UDB_PA3_CFG1
Tx__PA__CFG10 EQU CYREG_UDB_PA3_CFG10
Tx__PA__CFG11 EQU CYREG_UDB_PA3_CFG11
Tx__PA__CFG12 EQU CYREG_UDB_PA3_CFG12
Tx__PA__CFG13 EQU CYREG_UDB_PA3_CFG13
Tx__PA__CFG14 EQU CYREG_UDB_PA3_CFG14
Tx__PA__CFG2 EQU CYREG_UDB_PA3_CFG2
Tx__PA__CFG3 EQU CYREG_UDB_PA3_CFG3
Tx__PA__CFG4 EQU CYREG_UDB_PA3_CFG4
Tx__PA__CFG5 EQU CYREG_UDB_PA3_CFG5
Tx__PA__CFG6 EQU CYREG_UDB_PA3_CFG6
Tx__PA__CFG7 EQU CYREG_UDB_PA3_CFG7
Tx__PA__CFG8 EQU CYREG_UDB_PA3_CFG8
Tx__PA__CFG9 EQU CYREG_UDB_PA3_CFG9
Tx__PC EQU CYREG_GPIO_PRT3_PC
Tx__PC2 EQU CYREG_GPIO_PRT3_PC2
Tx__PORT EQU 3
Tx__PS EQU CYREG_GPIO_PRT3_PS
Tx__SHIFT EQU 0

; UART_BUART
UART_BUART_sRX_RxBitCounter__16BIT_CONTROL_AUX_CTL_REG EQU CYREG_UDB_W16_ACTL1
UART_BUART_sRX_RxBitCounter__16BIT_CONTROL_CONTROL_REG EQU CYREG_UDB_W16_CTL1
UART_BUART_sRX_RxBitCounter__16BIT_CONTROL_COUNT_REG EQU CYREG_UDB_W16_CTL1
UART_BUART_sRX_RxBitCounter__16BIT_COUNT_CONTROL_REG EQU CYREG_UDB_W16_CTL1
UART_BUART_sRX_RxBitCounter__16BIT_COUNT_COUNT_REG EQU CYREG_UDB_W16_CTL1
UART_BUART_sRX_RxBitCounter__16BIT_MASK_MASK_REG EQU CYREG_UDB_W16_MSK1
UART_BUART_sRX_RxBitCounter__16BIT_MASK_PERIOD_REG EQU CYREG_UDB_W16_MSK1
UART_BUART_sRX_RxBitCounter__16BIT_PERIOD_MASK_REG EQU CYREG_UDB_W16_MSK1
UART_BUART_sRX_RxBitCounter__16BIT_PERIOD_PERIOD_REG EQU CYREG_UDB_W16_MSK1
UART_BUART_sRX_RxBitCounter__CONTROL_AUX_CTL_REG EQU CYREG_UDB_W8_ACTL1
UART_BUART_sRX_RxBitCounter__CONTROL_REG EQU CYREG_UDB_W8_CTL1
UART_BUART_sRX_RxBitCounter__CONTROL_ST_REG EQU CYREG_UDB_CAT16_CTL_ST1
UART_BUART_sRX_RxBitCounter__COUNT_REG EQU CYREG_UDB_W8_CTL1
UART_BUART_sRX_RxBitCounter__COUNT_ST_REG EQU CYREG_UDB_CAT16_CTL_ST1
UART_BUART_sRX_RxBitCounter__MASK_CTL_AUX_CTL_REG EQU CYREG_UDB_CAT16_ACTL_MSK1
UART_BUART_sRX_RxBitCounter__PER_CTL_AUX_CTL_REG EQU CYREG_UDB_CAT16_ACTL_MSK1
UART_BUART_sRX_RxBitCounter__PERIOD_REG EQU CYREG_UDB_W8_MSK1
UART_BUART_sRX_RxBitCounter_ST__16BIT_STATUS_AUX_CTL_REG EQU CYREG_UDB_W16_ACTL1
UART_BUART_sRX_RxBitCounter_ST__16BIT_STATUS_REG EQU CYREG_UDB_W16_ST1
UART_BUART_sRX_RxBitCounter_ST__MASK_REG EQU CYREG_UDB_W8_MSK1
UART_BUART_sRX_RxBitCounter_ST__MASK_ST_AUX_CTL_REG EQU CYREG_UDB_CAT16_ACTL_MSK1
UART_BUART_sRX_RxBitCounter_ST__PER_ST_AUX_CTL_REG EQU CYREG_UDB_CAT16_ACTL_MSK1
UART_BUART_sRX_RxBitCounter_ST__STATUS_AUX_CTL_REG EQU CYREG_UDB_W8_ACTL1
UART_BUART_sRX_RxBitCounter_ST__STATUS_CNT_REG EQU CYREG_UDB_CAT16_CTL_ST1
UART_BUART_sRX_RxBitCounter_ST__STATUS_CONTROL_REG EQU CYREG_UDB_CAT16_CTL_ST1
UART_BUART_sRX_RxBitCounter_ST__STATUS_REG EQU CYREG_UDB_W8_ST1
UART_BUART_sRX_RxShifter_u0__16BIT_A0_REG EQU CYREG_UDB_W16_A01
UART_BUART_sRX_RxShifter_u0__16BIT_A1_REG EQU CYREG_UDB_W16_A11
UART_BUART_sRX_RxShifter_u0__16BIT_D0_REG EQU CYREG_UDB_W16_D01
UART_BUART_sRX_RxShifter_u0__16BIT_D1_REG EQU CYREG_UDB_W16_D11
UART_BUART_sRX_RxShifter_u0__16BIT_DP_AUX_CTL_REG EQU CYREG_UDB_W16_ACTL1
UART_BUART_sRX_RxShifter_u0__16BIT_F0_REG EQU CYREG_UDB_W16_F01
UART_BUART_sRX_RxShifter_u0__16BIT_F1_REG EQU CYREG_UDB_W16_F11
UART_BUART_sRX_RxShifter_u0__A0_A1_REG EQU CYREG_UDB_CAT16_A1
UART_BUART_sRX_RxShifter_u0__A0_REG EQU CYREG_UDB_W8_A01
UART_BUART_sRX_RxShifter_u0__A1_REG EQU CYREG_UDB_W8_A11
UART_BUART_sRX_RxShifter_u0__D0_D1_REG EQU CYREG_UDB_CAT16_D1
UART_BUART_sRX_RxShifter_u0__D0_REG EQU CYREG_UDB_W8_D01
UART_BUART_sRX_RxShifter_u0__D1_REG EQU CYREG_UDB_W8_D11
UART_BUART_sRX_RxShifter_u0__DP_AUX_CTL_REG EQU CYREG_UDB_W8_ACTL1
UART_BUART_sRX_RxShifter_u0__F0_F1_REG EQU CYREG_UDB_CAT16_F1
UART_BUART_sRX_RxShifter_u0__F0_REG EQU CYREG_UDB_W8_F01
UART_BUART_sRX_RxShifter_u0__F1_REG EQU CYREG_UDB_W8_F11
UART_BUART_sRX_RxShifter_u0__MSK_DP_AUX_CTL_REG EQU CYREG_UDB_CAT16_ACTL_MSK1
UART_BUART_sRX_RxShifter_u0__PER_DP_AUX_CTL_REG EQU CYREG_UDB_CAT16_ACTL_MSK1
UART_BUART_sRX_RxSts__16BIT_STATUS_AUX_CTL_REG EQU CYREG_UDB_W16_ACTL0
UART_BUART_sRX_RxSts__16BIT_STATUS_REG EQU CYREG_UDB_W16_ST0
UART_BUART_sRX_RxSts__3__MASK EQU 0x08
UART_BUART_sRX_RxSts__3__POS EQU 3
UART_BUART_sRX_RxSts__32BIT_MASK_REG EQU CYREG_UDB_W32_MSK
UART_BUART_sRX_RxSts__32BIT_STATUS_AUX_CTL_REG EQU CYREG_UDB_W32_ACTL
UART_BUART_sRX_RxSts__32BIT_STATUS_REG EQU CYREG_UDB_W32_ST
UART_BUART_sRX_RxSts__4__MASK EQU 0x10
UART_BUART_sRX_RxSts__4__POS EQU 4
UART_BUART_sRX_RxSts__5__MASK EQU 0x20
UART_BUART_sRX_RxSts__5__POS EQU 5
UART_BUART_sRX_RxSts__MASK EQU 0x38
UART_BUART_sRX_RxSts__MASK_REG EQU CYREG_UDB_W8_MSK0
UART_BUART_sRX_RxSts__MASK_ST_AUX_CTL_REG EQU CYREG_UDB_CAT16_ACTL_MSK0
UART_BUART_sRX_RxSts__PER_ST_AUX_CTL_REG EQU CYREG_UDB_CAT16_ACTL_MSK0
UART_BUART_sRX_RxSts__STATUS_AUX_CTL_REG EQU CYREG_UDB_W8_ACTL0
UART_BUART_sRX_RxSts__STATUS_CNT_REG EQU CYREG_UDB_CAT16_CTL_ST0
UART_BUART_sRX_RxSts__STATUS_CONTROL_REG EQU CYREG_UDB_CAT16_CTL_ST0
UART_BUART_sRX_RxSts__STATUS_REG EQU CYREG_UDB_W8_ST0
UART_BUART_sTX_sCLOCK_TxBitClkGen__A0_A1_REG EQU CYREG_UDB_CAT16_A3
UART_BUART_sTX_sCLOCK_TxBitClkGen__A0_REG EQU CYREG_UDB_W8_A03
UART_BUART_sTX_sCLOCK_TxBitClkGen__A1_REG EQU CYREG_UDB_W8_A13
UART_BUART_sTX_sCLOCK_TxBitClkGen__D0_D1_REG EQU CYREG_UDB_CAT16_D3
UART_BUART_sTX_sCLOCK_TxBitClkGen__D0_REG EQU CYREG_UDB_W8_D03
UART_BUART_sTX_sCLOCK_TxBitClkGen__D1_REG EQU CYREG_UDB_W8_D13
UART_BUART_sTX_sCLOCK_TxBitClkGen__DP_AUX_CTL_REG EQU CYREG_UDB_W8_ACTL3
UART_BUART_sTX_sCLOCK_TxBitClkGen__F0_F1_REG EQU CYREG_UDB_CAT16_F3
UART_BUART_sTX_sCLOCK_TxBitClkGen__F0_REG EQU CYREG_UDB_W8_F03
UART_BUART_sTX_sCLOCK_TxBitClkGen__F1_REG EQU CYREG_UDB_W8_F13
UART_BUART_sTX_TxShifter_u0__16BIT_A0_REG EQU CYREG_UDB_W16_A02
UART_BUART_sTX_TxShifter_u0__16BIT_A1_REG EQU CYREG_UDB_W16_A12
UART_BUART_sTX_TxShifter_u0__16BIT_D0_REG EQU CYREG_UDB_W16_D02
UART_BUART_sTX_TxShifter_u0__16BIT_D1_REG EQU CYREG_UDB_W16_D12
UART_BUART_sTX_TxShifter_u0__16BIT_DP_AUX_CTL_REG EQU CYREG_UDB_W16_ACTL2
UART_BUART_sTX_TxShifter_u0__16BIT_F0_REG EQU CYREG_UDB_W16_F02
UART_BUART_sTX_TxShifter_u0__16BIT_F1_REG EQU CYREG_UDB_W16_F12
UART_BUART_sTX_TxShifter_u0__A0_A1_REG EQU CYREG_UDB_CAT16_A2
UART_BUART_sTX_TxShifter_u0__A0_REG EQU CYREG_UDB_W8_A02
UART_BUART_sTX_TxShifter_u0__A1_REG EQU CYREG_UDB_W8_A12
UART_BUART_sTX_TxShifter_u0__D0_D1_REG EQU CYREG_UDB_CAT16_D2
UART_BUART_sTX_TxShifter_u0__D0_REG EQU CYREG_UDB_W8_D02
UART_BUART_sTX_TxShifter_u0__D1_REG EQU CYREG_UDB_W8_D12
UART_BUART_sTX_TxShifter_u0__DP_AUX_CTL_REG EQU CYREG_UDB_W8_ACTL2
UART_BUART_sTX_TxShifter_u0__F0_F1_REG EQU CYREG_UDB_CAT16_F2
UART_BUART_sTX_TxShifter_u0__F0_REG EQU CYREG_UDB_W8_F02
UART_BUART_sTX_TxShifter_u0__F1_REG EQU CYREG_UDB_W8_F12
UART_BUART_sTX_TxSts__0__MASK EQU 0x01
UART_BUART_sTX_TxSts__0__POS EQU 0
UART_BUART_sTX_TxSts__1__MASK EQU 0x02
UART_BUART_sTX_TxSts__1__POS EQU 1
UART_BUART_sTX_TxSts__16BIT_STATUS_AUX_CTL_REG EQU CYREG_UDB_W16_ACTL2
UART_BUART_sTX_TxSts__16BIT_STATUS_REG EQU CYREG_UDB_W16_ST2
UART_BUART_sTX_TxSts__2__MASK EQU 0x04
UART_BUART_sTX_TxSts__2__POS EQU 2
UART_BUART_sTX_TxSts__3__MASK EQU 0x08
UART_BUART_sTX_TxSts__3__POS EQU 3
UART_BUART_sTX_TxSts__MASK EQU 0x0F
UART_BUART_sTX_TxSts__MASK_REG EQU CYREG_UDB_W8_MSK2
UART_BUART_sTX_TxSts__STATUS_AUX_CTL_REG EQU CYREG_UDB_W8_ACTL2
UART_BUART_sTX_TxSts__STATUS_REG EQU CYREG_UDB_W8_ST2

; UART_IntClock
UART_IntClock__CTRL_REGISTER EQU CYREG_PERI_PCLK_CTL19
UART_IntClock__DIV_ID EQU 0x00000041
UART_IntClock__DIV_REGISTER EQU CYREG_PERI_DIV_16_CTL1
UART_IntClock__PA_DIV_ID EQU 0x000000FF

; SDPT_0
SDPT_0__0__DR EQU CYREG_GPIO_PRT2_DR
SDPT_0__0__DR_CLR EQU CYREG_GPIO_PRT2_DR_CLR
SDPT_0__0__DR_INV EQU CYREG_GPIO_PRT2_DR_INV
SDPT_0__0__DR_SET EQU CYREG_GPIO_PRT2_DR_SET
SDPT_0__0__HSIOM EQU CYREG_HSIOM_PORT_SEL2
SDPT_0__0__HSIOM_MASK EQU 0x0000000F
SDPT_0__0__HSIOM_SHIFT EQU 0
SDPT_0__0__INTCFG EQU CYREG_GPIO_PRT2_INTR_CFG
SDPT_0__0__INTR EQU CYREG_GPIO_PRT2_INTR
SDPT_0__0__INTR_CFG EQU CYREG_GPIO_PRT2_INTR_CFG
SDPT_0__0__INTSTAT EQU CYREG_GPIO_PRT2_INTR
SDPT_0__0__MASK EQU 0x01
SDPT_0__0__OUT_SEL EQU CYREG_UDB_PA2_CFG10
SDPT_0__0__OUT_SEL_SHIFT EQU 0
SDPT_0__0__OUT_SEL_VAL EQU 3
SDPT_0__0__PA__CFG0 EQU CYREG_UDB_PA2_CFG0
SDPT_0__0__PA__CFG1 EQU CYREG_UDB_PA2_CFG1
SDPT_0__0__PA__CFG10 EQU CYREG_UDB_PA2_CFG10
SDPT_0__0__PA__CFG11 EQU CYREG_UDB_PA2_CFG11
SDPT_0__0__PA__CFG12 EQU CYREG_UDB_PA2_CFG12
SDPT_0__0__PA__CFG13 EQU CYREG_UDB_PA2_CFG13
SDPT_0__0__PA__CFG14 EQU CYREG_UDB_PA2_CFG14
SDPT_0__0__PA__CFG2 EQU CYREG_UDB_PA2_CFG2
SDPT_0__0__PA__CFG3 EQU CYREG_UDB_PA2_CFG3
SDPT_0__0__PA__CFG4 EQU CYREG_UDB_PA2_CFG4
SDPT_0__0__PA__CFG5 EQU CYREG_UDB_PA2_CFG5
SDPT_0__0__PA__CFG6 EQU CYREG_UDB_PA2_CFG6
SDPT_0__0__PA__CFG7 EQU CYREG_UDB_PA2_CFG7
SDPT_0__0__PA__CFG8 EQU CYREG_UDB_PA2_CFG8
SDPT_0__0__PA__CFG9 EQU CYREG_UDB_PA2_CFG9
SDPT_0__0__PC EQU CYREG_GPIO_PRT2_PC
SDPT_0__0__PC2 EQU CYREG_GPIO_PRT2_PC2
SDPT_0__0__PORT EQU 2
SDPT_0__0__PS EQU CYREG_GPIO_PRT2_PS
SDPT_0__0__SHIFT EQU 0
SDPT_0__DR EQU CYREG_GPIO_PRT2_DR
SDPT_0__DR_CLR EQU CYREG_GPIO_PRT2_DR_CLR
SDPT_0__DR_INV EQU CYREG_GPIO_PRT2_DR_INV
SDPT_0__DR_SET EQU CYREG_GPIO_PRT2_DR_SET
SDPT_0__INTCFG EQU CYREG_GPIO_PRT2_INTR_CFG
SDPT_0__INTR EQU CYREG_GPIO_PRT2_INTR
SDPT_0__INTR_CFG EQU CYREG_GPIO_PRT2_INTR_CFG
SDPT_0__INTSTAT EQU CYREG_GPIO_PRT2_INTR
SDPT_0__MASK EQU 0x01
SDPT_0__PA__CFG0 EQU CYREG_UDB_PA2_CFG0
SDPT_0__PA__CFG1 EQU CYREG_UDB_PA2_CFG1
SDPT_0__PA__CFG10 EQU CYREG_UDB_PA2_CFG10
SDPT_0__PA__CFG11 EQU CYREG_UDB_PA2_CFG11
SDPT_0__PA__CFG12 EQU CYREG_UDB_PA2_CFG12
SDPT_0__PA__CFG13 EQU CYREG_UDB_PA2_CFG13
SDPT_0__PA__CFG14 EQU CYREG_UDB_PA2_CFG14
SDPT_0__PA__CFG2 EQU CYREG_UDB_PA2_CFG2
SDPT_0__PA__CFG3 EQU CYREG_UDB_PA2_CFG3
SDPT_0__PA__CFG4 EQU CYREG_UDB_PA2_CFG4
SDPT_0__PA__CFG5 EQU CYREG_UDB_PA2_CFG5
SDPT_0__PA__CFG6 EQU CYREG_UDB_PA2_CFG6
SDPT_0__PA__CFG7 EQU CYREG_UDB_PA2_CFG7
SDPT_0__PA__CFG8 EQU CYREG_UDB_PA2_CFG8
SDPT_0__PA__CFG9 EQU CYREG_UDB_PA2_CFG9
SDPT_0__PC EQU CYREG_GPIO_PRT2_PC
SDPT_0__PC2 EQU CYREG_GPIO_PRT2_PC2
SDPT_0__PORT EQU 2
SDPT_0__PS EQU CYREG_GPIO_PRT2_PS
SDPT_0__SHIFT EQU 0

; SP8T_0
SP8T_0__0__DR EQU CYREG_GPIO_PRT2_DR
SP8T_0__0__DR_CLR EQU CYREG_GPIO_PRT2_DR_CLR
SP8T_0__0__DR_INV EQU CYREG_GPIO_PRT2_DR_INV
SP8T_0__0__DR_SET EQU CYREG_GPIO_PRT2_DR_SET
SP8T_0__0__HSIOM EQU CYREG_HSIOM_PORT_SEL2
SP8T_0__0__HSIOM_MASK EQU 0x00000F00
SP8T_0__0__HSIOM_SHIFT EQU 8
SP8T_0__0__INTCFG EQU CYREG_GPIO_PRT2_INTR_CFG
SP8T_0__0__INTR EQU CYREG_GPIO_PRT2_INTR
SP8T_0__0__INTR_CFG EQU CYREG_GPIO_PRT2_INTR_CFG
SP8T_0__0__INTSTAT EQU CYREG_GPIO_PRT2_INTR
SP8T_0__0__MASK EQU 0x04
SP8T_0__0__OUT_SEL EQU CYREG_UDB_PA2_CFG10
SP8T_0__0__OUT_SEL_SHIFT EQU 4
SP8T_0__0__OUT_SEL_VAL EQU 2
SP8T_0__0__PA__CFG0 EQU CYREG_UDB_PA2_CFG0
SP8T_0__0__PA__CFG1 EQU CYREG_UDB_PA2_CFG1
SP8T_0__0__PA__CFG10 EQU CYREG_UDB_PA2_CFG10
SP8T_0__0__PA__CFG11 EQU CYREG_UDB_PA2_CFG11
SP8T_0__0__PA__CFG12 EQU CYREG_UDB_PA2_CFG12
SP8T_0__0__PA__CFG13 EQU CYREG_UDB_PA2_CFG13
SP8T_0__0__PA__CFG14 EQU CYREG_UDB_PA2_CFG14
SP8T_0__0__PA__CFG2 EQU CYREG_UDB_PA2_CFG2
SP8T_0__0__PA__CFG3 EQU CYREG_UDB_PA2_CFG3
SP8T_0__0__PA__CFG4 EQU CYREG_UDB_PA2_CFG4
SP8T_0__0__PA__CFG5 EQU CYREG_UDB_PA2_CFG5
SP8T_0__0__PA__CFG6 EQU CYREG_UDB_PA2_CFG6
SP8T_0__0__PA__CFG7 EQU CYREG_UDB_PA2_CFG7
SP8T_0__0__PA__CFG8 EQU CYREG_UDB_PA2_CFG8
SP8T_0__0__PA__CFG9 EQU CYREG_UDB_PA2_CFG9
SP8T_0__0__PC EQU CYREG_GPIO_PRT2_PC
SP8T_0__0__PC2 EQU CYREG_GPIO_PRT2_PC2
SP8T_0__0__PORT EQU 2
SP8T_0__0__PS EQU CYREG_GPIO_PRT2_PS
SP8T_0__0__SHIFT EQU 2
SP8T_0__DR EQU CYREG_GPIO_PRT2_DR
SP8T_0__DR_CLR EQU CYREG_GPIO_PRT2_DR_CLR
SP8T_0__DR_INV EQU CYREG_GPIO_PRT2_DR_INV
SP8T_0__DR_SET EQU CYREG_GPIO_PRT2_DR_SET
SP8T_0__INTCFG EQU CYREG_GPIO_PRT2_INTR_CFG
SP8T_0__INTR EQU CYREG_GPIO_PRT2_INTR
SP8T_0__INTR_CFG EQU CYREG_GPIO_PRT2_INTR_CFG
SP8T_0__INTSTAT EQU CYREG_GPIO_PRT2_INTR
SP8T_0__MASK EQU 0x04
SP8T_0__PA__CFG0 EQU CYREG_UDB_PA2_CFG0
SP8T_0__PA__CFG1 EQU CYREG_UDB_PA2_CFG1
SP8T_0__PA__CFG10 EQU CYREG_UDB_PA2_CFG10
SP8T_0__PA__CFG11 EQU CYREG_UDB_PA2_CFG11
SP8T_0__PA__CFG12 EQU CYREG_UDB_PA2_CFG12
SP8T_0__PA__CFG13 EQU CYREG_UDB_PA2_CFG13
SP8T_0__PA__CFG14 EQU CYREG_UDB_PA2_CFG14
SP8T_0__PA__CFG2 EQU CYREG_UDB_PA2_CFG2
SP8T_0__PA__CFG3 EQU CYREG_UDB_PA2_CFG3
SP8T_0__PA__CFG4 EQU CYREG_UDB_PA2_CFG4
SP8T_0__PA__CFG5 EQU CYREG_UDB_PA2_CFG5
SP8T_0__PA__CFG6 EQU CYREG_UDB_PA2_CFG6
SP8T_0__PA__CFG7 EQU CYREG_UDB_PA2_CFG7
SP8T_0__PA__CFG8 EQU CYREG_UDB_PA2_CFG8
SP8T_0__PA__CFG9 EQU CYREG_UDB_PA2_CFG9
SP8T_0__PC EQU CYREG_GPIO_PRT2_PC
SP8T_0__PC2 EQU CYREG_GPIO_PRT2_PC2
SP8T_0__PORT EQU 2
SP8T_0__PS EQU CYREG_GPIO_PRT2_PS
SP8T_0__SHIFT EQU 2

; SP8T_1
SP8T_1__0__DR EQU CYREG_GPIO_PRT2_DR
SP8T_1__0__DR_CLR EQU CYREG_GPIO_PRT2_DR_CLR
SP8T_1__0__DR_INV EQU CYREG_GPIO_PRT2_DR_INV
SP8T_1__0__DR_SET EQU CYREG_GPIO_PRT2_DR_SET
SP8T_1__0__HSIOM EQU CYREG_HSIOM_PORT_SEL2
SP8T_1__0__HSIOM_MASK EQU 0x0000F000
SP8T_1__0__HSIOM_SHIFT EQU 12
SP8T_1__0__INTCFG EQU CYREG_GPIO_PRT2_INTR_CFG
SP8T_1__0__INTR EQU CYREG_GPIO_PRT2_INTR
SP8T_1__0__INTR_CFG EQU CYREG_GPIO_PRT2_INTR_CFG
SP8T_1__0__INTSTAT EQU CYREG_GPIO_PRT2_INTR
SP8T_1__0__MASK EQU 0x08
SP8T_1__0__OUT_SEL EQU CYREG_UDB_PA2_CFG10
SP8T_1__0__OUT_SEL_SHIFT EQU 6
SP8T_1__0__OUT_SEL_VAL EQU 1
SP8T_1__0__PA__CFG0 EQU CYREG_UDB_PA2_CFG0
SP8T_1__0__PA__CFG1 EQU CYREG_UDB_PA2_CFG1
SP8T_1__0__PA__CFG10 EQU CYREG_UDB_PA2_CFG10
SP8T_1__0__PA__CFG11 EQU CYREG_UDB_PA2_CFG11
SP8T_1__0__PA__CFG12 EQU CYREG_UDB_PA2_CFG12
SP8T_1__0__PA__CFG13 EQU CYREG_UDB_PA2_CFG13
SP8T_1__0__PA__CFG14 EQU CYREG_UDB_PA2_CFG14
SP8T_1__0__PA__CFG2 EQU CYREG_UDB_PA2_CFG2
SP8T_1__0__PA__CFG3 EQU CYREG_UDB_PA2_CFG3
SP8T_1__0__PA__CFG4 EQU CYREG_UDB_PA2_CFG4
SP8T_1__0__PA__CFG5 EQU CYREG_UDB_PA2_CFG5
SP8T_1__0__PA__CFG6 EQU CYREG_UDB_PA2_CFG6
SP8T_1__0__PA__CFG7 EQU CYREG_UDB_PA2_CFG7
SP8T_1__0__PA__CFG8 EQU CYREG_UDB_PA2_CFG8
SP8T_1__0__PA__CFG9 EQU CYREG_UDB_PA2_CFG9
SP8T_1__0__PC EQU CYREG_GPIO_PRT2_PC
SP8T_1__0__PC2 EQU CYREG_GPIO_PRT2_PC2
SP8T_1__0__PORT EQU 2
SP8T_1__0__PS EQU CYREG_GPIO_PRT2_PS
SP8T_1__0__SHIFT EQU 3
SP8T_1__DR EQU CYREG_GPIO_PRT2_DR
SP8T_1__DR_CLR EQU CYREG_GPIO_PRT2_DR_CLR
SP8T_1__DR_INV EQU CYREG_GPIO_PRT2_DR_INV
SP8T_1__DR_SET EQU CYREG_GPIO_PRT2_DR_SET
SP8T_1__INTCFG EQU CYREG_GPIO_PRT2_INTR_CFG
SP8T_1__INTR EQU CYREG_GPIO_PRT2_INTR
SP8T_1__INTR_CFG EQU CYREG_GPIO_PRT2_INTR_CFG
SP8T_1__INTSTAT EQU CYREG_GPIO_PRT2_INTR
SP8T_1__MASK EQU 0x08
SP8T_1__PA__CFG0 EQU CYREG_UDB_PA2_CFG0
SP8T_1__PA__CFG1 EQU CYREG_UDB_PA2_CFG1
SP8T_1__PA__CFG10 EQU CYREG_UDB_PA2_CFG10
SP8T_1__PA__CFG11 EQU CYREG_UDB_PA2_CFG11
SP8T_1__PA__CFG12 EQU CYREG_UDB_PA2_CFG12
SP8T_1__PA__CFG13 EQU CYREG_UDB_PA2_CFG13
SP8T_1__PA__CFG14 EQU CYREG_UDB_PA2_CFG14
SP8T_1__PA__CFG2 EQU CYREG_UDB_PA2_CFG2
SP8T_1__PA__CFG3 EQU CYREG_UDB_PA2_CFG3
SP8T_1__PA__CFG4 EQU CYREG_UDB_PA2_CFG4
SP8T_1__PA__CFG5 EQU CYREG_UDB_PA2_CFG5
SP8T_1__PA__CFG6 EQU CYREG_UDB_PA2_CFG6
SP8T_1__PA__CFG7 EQU CYREG_UDB_PA2_CFG7
SP8T_1__PA__CFG8 EQU CYREG_UDB_PA2_CFG8
SP8T_1__PA__CFG9 EQU CYREG_UDB_PA2_CFG9
SP8T_1__PC EQU CYREG_GPIO_PRT2_PC
SP8T_1__PC2 EQU CYREG_GPIO_PRT2_PC2
SP8T_1__PORT EQU 2
SP8T_1__PS EQU CYREG_GPIO_PRT2_PS
SP8T_1__SHIFT EQU 3

; SP8T_2
SP8T_2__0__DR EQU CYREG_GPIO_PRT2_DR
SP8T_2__0__DR_CLR EQU CYREG_GPIO_PRT2_DR_CLR
SP8T_2__0__DR_INV EQU CYREG_GPIO_PRT2_DR_INV
SP8T_2__0__DR_SET EQU CYREG_GPIO_PRT2_DR_SET
SP8T_2__0__HSIOM EQU CYREG_HSIOM_PORT_SEL2
SP8T_2__0__HSIOM_MASK EQU 0x000F0000
SP8T_2__0__HSIOM_SHIFT EQU 16
SP8T_2__0__INTCFG EQU CYREG_GPIO_PRT2_INTR_CFG
SP8T_2__0__INTR EQU CYREG_GPIO_PRT2_INTR
SP8T_2__0__INTR_CFG EQU CYREG_GPIO_PRT2_INTR_CFG
SP8T_2__0__INTSTAT EQU CYREG_GPIO_PRT2_INTR
SP8T_2__0__MASK EQU 0x10
SP8T_2__0__OUT_SEL EQU CYREG_UDB_PA2_CFG10
SP8T_2__0__OUT_SEL_SHIFT EQU 8
SP8T_2__0__OUT_SEL_VAL EQU 2
SP8T_2__0__PA__CFG0 EQU CYREG_UDB_PA2_CFG0
SP8T_2__0__PA__CFG1 EQU CYREG_UDB_PA2_CFG1
SP8T_2__0__PA__CFG10 EQU CYREG_UDB_PA2_CFG10
SP8T_2__0__PA__CFG11 EQU CYREG_UDB_PA2_CFG11
SP8T_2__0__PA__CFG12 EQU CYREG_UDB_PA2_CFG12
SP8T_2__0__PA__CFG13 EQU CYREG_UDB_PA2_CFG13
SP8T_2__0__PA__CFG14 EQU CYREG_UDB_PA2_CFG14
SP8T_2__0__PA__CFG2 EQU CYREG_UDB_PA2_CFG2
SP8T_2__0__PA__CFG3 EQU CYREG_UDB_PA2_CFG3
SP8T_2__0__PA__CFG4 EQU CYREG_UDB_PA2_CFG4
SP8T_2__0__PA__CFG5 EQU CYREG_UDB_PA2_CFG5
SP8T_2__0__PA__CFG6 EQU CYREG_UDB_PA2_CFG6
SP8T_2__0__PA__CFG7 EQU CYREG_UDB_PA2_CFG7
SP8T_2__0__PA__CFG8 EQU CYREG_UDB_PA2_CFG8
SP8T_2__0__PA__CFG9 EQU CYREG_UDB_PA2_CFG9
SP8T_2__0__PC EQU CYREG_GPIO_PRT2_PC
SP8T_2__0__PC2 EQU CYREG_GPIO_PRT2_PC2
SP8T_2__0__PORT EQU 2
SP8T_2__0__PS EQU CYREG_GPIO_PRT2_PS
SP8T_2__0__SHIFT EQU 4
SP8T_2__DR EQU CYREG_GPIO_PRT2_DR
SP8T_2__DR_CLR EQU CYREG_GPIO_PRT2_DR_CLR
SP8T_2__DR_INV EQU CYREG_GPIO_PRT2_DR_INV
SP8T_2__DR_SET EQU CYREG_GPIO_PRT2_DR_SET
SP8T_2__INTCFG EQU CYREG_GPIO_PRT2_INTR_CFG
SP8T_2__INTR EQU CYREG_GPIO_PRT2_INTR
SP8T_2__INTR_CFG EQU CYREG_GPIO_PRT2_INTR_CFG
SP8T_2__INTSTAT EQU CYREG_GPIO_PRT2_INTR
SP8T_2__MASK EQU 0x10
SP8T_2__PA__CFG0 EQU CYREG_UDB_PA2_CFG0
SP8T_2__PA__CFG1 EQU CYREG_UDB_PA2_CFG1
SP8T_2__PA__CFG10 EQU CYREG_UDB_PA2_CFG10
SP8T_2__PA__CFG11 EQU CYREG_UDB_PA2_CFG11
SP8T_2__PA__CFG12 EQU CYREG_UDB_PA2_CFG12
SP8T_2__PA__CFG13 EQU CYREG_UDB_PA2_CFG13
SP8T_2__PA__CFG14 EQU CYREG_UDB_PA2_CFG14
SP8T_2__PA__CFG2 EQU CYREG_UDB_PA2_CFG2
SP8T_2__PA__CFG3 EQU CYREG_UDB_PA2_CFG3
SP8T_2__PA__CFG4 EQU CYREG_UDB_PA2_CFG4
SP8T_2__PA__CFG5 EQU CYREG_UDB_PA2_CFG5
SP8T_2__PA__CFG6 EQU CYREG_UDB_PA2_CFG6
SP8T_2__PA__CFG7 EQU CYREG_UDB_PA2_CFG7
SP8T_2__PA__CFG8 EQU CYREG_UDB_PA2_CFG8
SP8T_2__PA__CFG9 EQU CYREG_UDB_PA2_CFG9
SP8T_2__PC EQU CYREG_GPIO_PRT2_PC
SP8T_2__PC2 EQU CYREG_GPIO_PRT2_PC2
SP8T_2__PORT EQU 2
SP8T_2__PS EQU CYREG_GPIO_PRT2_PS
SP8T_2__SHIFT EQU 4

; SPDT_1
SPDT_1__0__DR EQU CYREG_GPIO_PRT2_DR
SPDT_1__0__DR_CLR EQU CYREG_GPIO_PRT2_DR_CLR
SPDT_1__0__DR_INV EQU CYREG_GPIO_PRT2_DR_INV
SPDT_1__0__DR_SET EQU CYREG_GPIO_PRT2_DR_SET
SPDT_1__0__HSIOM EQU CYREG_HSIOM_PORT_SEL2
SPDT_1__0__HSIOM_MASK EQU 0x000000F0
SPDT_1__0__HSIOM_SHIFT EQU 4
SPDT_1__0__INTCFG EQU CYREG_GPIO_PRT2_INTR_CFG
SPDT_1__0__INTR EQU CYREG_GPIO_PRT2_INTR
SPDT_1__0__INTR_CFG EQU CYREG_GPIO_PRT2_INTR_CFG
SPDT_1__0__INTSTAT EQU CYREG_GPIO_PRT2_INTR
SPDT_1__0__MASK EQU 0x02
SPDT_1__0__OUT_SEL EQU CYREG_UDB_PA2_CFG10
SPDT_1__0__OUT_SEL_SHIFT EQU 2
SPDT_1__0__OUT_SEL_VAL EQU 0
SPDT_1__0__PA__CFG0 EQU CYREG_UDB_PA2_CFG0
SPDT_1__0__PA__CFG1 EQU CYREG_UDB_PA2_CFG1
SPDT_1__0__PA__CFG10 EQU CYREG_UDB_PA2_CFG10
SPDT_1__0__PA__CFG11 EQU CYREG_UDB_PA2_CFG11
SPDT_1__0__PA__CFG12 EQU CYREG_UDB_PA2_CFG12
SPDT_1__0__PA__CFG13 EQU CYREG_UDB_PA2_CFG13
SPDT_1__0__PA__CFG14 EQU CYREG_UDB_PA2_CFG14
SPDT_1__0__PA__CFG2 EQU CYREG_UDB_PA2_CFG2
SPDT_1__0__PA__CFG3 EQU CYREG_UDB_PA2_CFG3
SPDT_1__0__PA__CFG4 EQU CYREG_UDB_PA2_CFG4
SPDT_1__0__PA__CFG5 EQU CYREG_UDB_PA2_CFG5
SPDT_1__0__PA__CFG6 EQU CYREG_UDB_PA2_CFG6
SPDT_1__0__PA__CFG7 EQU CYREG_UDB_PA2_CFG7
SPDT_1__0__PA__CFG8 EQU CYREG_UDB_PA2_CFG8
SPDT_1__0__PA__CFG9 EQU CYREG_UDB_PA2_CFG9
SPDT_1__0__PC EQU CYREG_GPIO_PRT2_PC
SPDT_1__0__PC2 EQU CYREG_GPIO_PRT2_PC2
SPDT_1__0__PORT EQU 2
SPDT_1__0__PS EQU CYREG_GPIO_PRT2_PS
SPDT_1__0__SHIFT EQU 1
SPDT_1__DR EQU CYREG_GPIO_PRT2_DR
SPDT_1__DR_CLR EQU CYREG_GPIO_PRT2_DR_CLR
SPDT_1__DR_INV EQU CYREG_GPIO_PRT2_DR_INV
SPDT_1__DR_SET EQU CYREG_GPIO_PRT2_DR_SET
SPDT_1__INTCFG EQU CYREG_GPIO_PRT2_INTR_CFG
SPDT_1__INTR EQU CYREG_GPIO_PRT2_INTR
SPDT_1__INTR_CFG EQU CYREG_GPIO_PRT2_INTR_CFG
SPDT_1__INTSTAT EQU CYREG_GPIO_PRT2_INTR
SPDT_1__MASK EQU 0x02
SPDT_1__PA__CFG0 EQU CYREG_UDB_PA2_CFG0
SPDT_1__PA__CFG1 EQU CYREG_UDB_PA2_CFG1
SPDT_1__PA__CFG10 EQU CYREG_UDB_PA2_CFG10
SPDT_1__PA__CFG11 EQU CYREG_UDB_PA2_CFG11
SPDT_1__PA__CFG12 EQU CYREG_UDB_PA2_CFG12
SPDT_1__PA__CFG13 EQU CYREG_UDB_PA2_CFG13
SPDT_1__PA__CFG14 EQU CYREG_UDB_PA2_CFG14
SPDT_1__PA__CFG2 EQU CYREG_UDB_PA2_CFG2
SPDT_1__PA__CFG3 EQU CYREG_UDB_PA2_CFG3
SPDT_1__PA__CFG4 EQU CYREG_UDB_PA2_CFG4
SPDT_1__PA__CFG5 EQU CYREG_UDB_PA2_CFG5
SPDT_1__PA__CFG6 EQU CYREG_UDB_PA2_CFG6
SPDT_1__PA__CFG7 EQU CYREG_UDB_PA2_CFG7
SPDT_1__PA__CFG8 EQU CYREG_UDB_PA2_CFG8
SPDT_1__PA__CFG9 EQU CYREG_UDB_PA2_CFG9
SPDT_1__PC EQU CYREG_GPIO_PRT2_PC
SPDT_1__PC2 EQU CYREG_GPIO_PRT2_PC2
SPDT_1__PORT EQU 2
SPDT_1__PS EQU CYREG_GPIO_PRT2_PS
SPDT_1__SHIFT EQU 1

; OutputReg
OutputReg_Sync_ctrl_reg__0__MASK EQU 0x01
OutputReg_Sync_ctrl_reg__0__POS EQU 0
OutputReg_Sync_ctrl_reg__1__MASK EQU 0x02
OutputReg_Sync_ctrl_reg__1__POS EQU 1
OutputReg_Sync_ctrl_reg__16BIT_CONTROL_AUX_CTL_REG EQU CYREG_UDB_W16_ACTL0
OutputReg_Sync_ctrl_reg__16BIT_CONTROL_CONTROL_REG EQU CYREG_UDB_W16_CTL0
OutputReg_Sync_ctrl_reg__16BIT_CONTROL_COUNT_REG EQU CYREG_UDB_W16_CTL0
OutputReg_Sync_ctrl_reg__16BIT_COUNT_CONTROL_REG EQU CYREG_UDB_W16_CTL0
OutputReg_Sync_ctrl_reg__16BIT_COUNT_COUNT_REG EQU CYREG_UDB_W16_CTL0
OutputReg_Sync_ctrl_reg__16BIT_MASK_MASK_REG EQU CYREG_UDB_W16_MSK0
OutputReg_Sync_ctrl_reg__16BIT_MASK_PERIOD_REG EQU CYREG_UDB_W16_MSK0
OutputReg_Sync_ctrl_reg__16BIT_PERIOD_MASK_REG EQU CYREG_UDB_W16_MSK0
OutputReg_Sync_ctrl_reg__16BIT_PERIOD_PERIOD_REG EQU CYREG_UDB_W16_MSK0
OutputReg_Sync_ctrl_reg__2__MASK EQU 0x04
OutputReg_Sync_ctrl_reg__2__POS EQU 2
OutputReg_Sync_ctrl_reg__3__MASK EQU 0x08
OutputReg_Sync_ctrl_reg__3__POS EQU 3
OutputReg_Sync_ctrl_reg__32BIT_CONTROL_AUX_CTL_REG EQU CYREG_UDB_W32_ACTL
OutputReg_Sync_ctrl_reg__32BIT_CONTROL_REG EQU CYREG_UDB_W32_CTL
OutputReg_Sync_ctrl_reg__32BIT_COUNT_REG EQU CYREG_UDB_W32_CTL
OutputReg_Sync_ctrl_reg__32BIT_PERIOD_REG EQU CYREG_UDB_W32_MSK
OutputReg_Sync_ctrl_reg__4__MASK EQU 0x10
OutputReg_Sync_ctrl_reg__4__POS EQU 4
OutputReg_Sync_ctrl_reg__CONTROL_AUX_CTL_REG EQU CYREG_UDB_W8_ACTL0
OutputReg_Sync_ctrl_reg__CONTROL_REG EQU CYREG_UDB_W8_CTL0
OutputReg_Sync_ctrl_reg__CONTROL_ST_REG EQU CYREG_UDB_CAT16_CTL_ST0
OutputReg_Sync_ctrl_reg__COUNT_REG EQU CYREG_UDB_W8_CTL0
OutputReg_Sync_ctrl_reg__COUNT_ST_REG EQU CYREG_UDB_CAT16_CTL_ST0
OutputReg_Sync_ctrl_reg__MASK EQU 0x1F
OutputReg_Sync_ctrl_reg__MASK_CTL_AUX_CTL_REG EQU CYREG_UDB_CAT16_ACTL_MSK0
OutputReg_Sync_ctrl_reg__PER_CTL_AUX_CTL_REG EQU CYREG_UDB_CAT16_ACTL_MSK0
OutputReg_Sync_ctrl_reg__PERIOD_REG EQU CYREG_UDB_W8_MSK0

; uartRx_isr
uartRx_isr__INTC_CLR_EN_REG EQU CYREG_CM0_ICER
uartRx_isr__INTC_CLR_PD_REG EQU CYREG_CM0_ICPR
uartRx_isr__INTC_MASK EQU 0x01
uartRx_isr__INTC_NUMBER EQU 0
uartRx_isr__INTC_PRIOR_MASK EQU 0xC0
uartRx_isr__INTC_PRIOR_NUM EQU 3
uartRx_isr__INTC_PRIOR_REG EQU CYREG_CM0_IPR0
uartRx_isr__INTC_SET_EN_REG EQU CYREG_CM0_ISER
uartRx_isr__INTC_SET_PD_REG EQU CYREG_CM0_ISPR

; Miscellaneous
CYDEV_BCLK__HFCLK__HZ EQU 48000000
CYDEV_BCLK__HFCLK__KHZ EQU 48000
CYDEV_BCLK__HFCLK__MHZ EQU 48
CYDEV_BCLK__SYSCLK__HZ EQU 1500000
CYDEV_BCLK__SYSCLK__KHZ EQU 1500
CYDEV_BCLK__SYSCLK__MHZ EQU 1
CYDEV_CHIP_DIE_GEN4 EQU 2
CYDEV_CHIP_DIE_LEOPARD EQU 1
CYDEV_CHIP_DIE_PANTHER EQU 12
CYDEV_CHIP_DIE_PSOC4A EQU 5
CYDEV_CHIP_DIE_PSOC5LP EQU 11
CYDEV_CHIP_DIE_UNKNOWN EQU 0
CYDEV_CHIP_FAMILY_PSOC3 EQU 1
CYDEV_CHIP_FAMILY_PSOC4 EQU 2
CYDEV_CHIP_FAMILY_PSOC5 EQU 3
CYDEV_CHIP_FAMILY_UNKNOWN EQU 0
CYDEV_CHIP_FAMILY_USED EQU CYDEV_CHIP_FAMILY_PSOC4
CYDEV_CHIP_JTAG_ID EQU 0x112D11A1
CYDEV_CHIP_MEMBER_3A EQU 1
CYDEV_CHIP_MEMBER_4A EQU 5
CYDEV_CHIP_MEMBER_4C EQU 9
CYDEV_CHIP_MEMBER_4D EQU 3
CYDEV_CHIP_MEMBER_4E EQU 4
CYDEV_CHIP_MEMBER_4F EQU 6
CYDEV_CHIP_MEMBER_4G EQU 2
CYDEV_CHIP_MEMBER_4L EQU 8
CYDEV_CHIP_MEMBER_4M EQU 7
CYDEV_CHIP_MEMBER_5A EQU 11
CYDEV_CHIP_MEMBER_5B EQU 10
CYDEV_CHIP_MEMBER_UNKNOWN EQU 0
CYDEV_CHIP_MEMBER_USED EQU CYDEV_CHIP_MEMBER_4M
CYDEV_CHIP_DIE_EXPECT EQU CYDEV_CHIP_MEMBER_USED
CYDEV_CHIP_DIE_ACTUAL EQU CYDEV_CHIP_DIE_EXPECT
CYDEV_CHIP_REV_GEN4_ES EQU 17
CYDEV_CHIP_REV_GEN4_ES2 EQU 33
CYDEV_CHIP_REV_GEN4_PRODUCTION EQU 17
CYDEV_CHIP_REV_LEOPARD_ES1 EQU 0
CYDEV_CHIP_REV_LEOPARD_ES2 EQU 1
CYDEV_CHIP_REV_LEOPARD_ES3 EQU 3
CYDEV_CHIP_REV_LEOPARD_PRODUCTION EQU 3
CYDEV_CHIP_REV_PANTHER_ES0 EQU 0
CYDEV_CHIP_REV_PANTHER_ES1 EQU 1
CYDEV_CHIP_REV_PANTHER_PRODUCTION EQU 1
CYDEV_CHIP_REV_PSOC4A_ES0 EQU 17
CYDEV_CHIP_REV_PSOC4A_PRODUCTION EQU 17
CYDEV_CHIP_REV_PSOC5LP_ES0 EQU 0
CYDEV_CHIP_REV_PSOC5LP_PRODUCTION EQU 0
CYDEV_CHIP_REVISION_3A_ES1 EQU 0
CYDEV_CHIP_REVISION_3A_ES2 EQU 1
CYDEV_CHIP_REVISION_3A_ES3 EQU 3
CYDEV_CHIP_REVISION_3A_PRODUCTION EQU 3
CYDEV_CHIP_REVISION_4A_ES0 EQU 17
CYDEV_CHIP_REVISION_4A_PRODUCTION EQU 17
CYDEV_CHIP_REVISION_4C_PRODUCTION EQU 0
CYDEV_CHIP_REVISION_4D_PRODUCTION EQU 0
CYDEV_CHIP_REVISION_4E_PRODUCTION EQU 0
CYDEV_CHIP_REVISION_4F_PRODUCTION EQU 0
CYDEV_CHIP_REVISION_4F_PRODUCTION_256K EQU 0
CYDEV_CHIP_REVISION_4G_ES EQU 17
CYDEV_CHIP_REVISION_4G_ES2 EQU 33
CYDEV_CHIP_REVISION_4G_PRODUCTION EQU 17
CYDEV_CHIP_REVISION_4L_PRODUCTION EQU 0
CYDEV_CHIP_REVISION_4M_PRODUCTION EQU 0
CYDEV_CHIP_REVISION_5A_ES0 EQU 0
CYDEV_CHIP_REVISION_5A_ES1 EQU 1
CYDEV_CHIP_REVISION_5A_PRODUCTION EQU 1
CYDEV_CHIP_REVISION_5B_ES0 EQU 0
CYDEV_CHIP_REVISION_5B_PRODUCTION EQU 0
CYDEV_CHIP_REVISION_USED EQU CYDEV_CHIP_REVISION_4M_PRODUCTION
CYDEV_CHIP_REV_EXPECT EQU CYDEV_CHIP_REVISION_USED
CYDEV_CONFIG_READ_ACCELERATOR EQU 1
CYDEV_CONFIG_UNUSED_IO_AllowButWarn EQU 0
CYDEV_CONFIG_UNUSED_IO EQU CYDEV_CONFIG_UNUSED_IO_AllowButWarn
CYDEV_CONFIG_UNUSED_IO_AllowWithInfo EQU 1
CYDEV_CONFIG_UNUSED_IO_Disallowed EQU 2
CYDEV_CONFIGURATION_COMPRESSED EQU 1
CYDEV_CONFIGURATION_MODE_COMPRESSED EQU 0
CYDEV_CONFIGURATION_MODE EQU CYDEV_CONFIGURATION_MODE_COMPRESSED
CYDEV_CONFIGURATION_MODE_DMA EQU 2
CYDEV_CONFIGURATION_MODE_UNCOMPRESSED EQU 1
CYDEV_DEBUG_PROTECT_KILL EQU 4
CYDEV_DEBUG_PROTECT_OPEN EQU 1
CYDEV_DEBUG_PROTECT EQU CYDEV_DEBUG_PROTECT_OPEN
CYDEV_DEBUG_PROTECT_PROTECTED EQU 2
CYDEV_DEBUGGING_DPS_Disable EQU 3
CYDEV_DEBUGGING_DPS_SWD EQU 2
CYDEV_DEBUGGING_DPS EQU CYDEV_DEBUGGING_DPS_SWD
CYDEV_DEBUGGING_ENABLE EQU 1
CYDEV_DFT_SELECT_CLK0 EQU 10
CYDEV_DFT_SELECT_CLK1 EQU 11
CYDEV_DMA_CHANNELS_AVAILABLE EQU 8
CYDEV_HEAP_SIZE EQU 0x800
CYDEV_IMO_TRIMMED_BY_WCO EQU 0
CYDEV_INTR_NUMBER_DMA EQU 13
CYDEV_PROJ_TYPE EQU 0
CYDEV_PROJ_TYPE_BOOTLOADER EQU 1
CYDEV_PROJ_TYPE_LAUNCHER EQU 5
CYDEV_PROJ_TYPE_LOADABLE EQU 2
CYDEV_PROJ_TYPE_LOADABLEANDBOOTLOADER EQU 4
CYDEV_PROJ_TYPE_MULTIAPPBOOTLOADER EQU 3
CYDEV_PROJ_TYPE_STANDARD EQU 0
CYDEV_STACK_SIZE EQU 0x1800
CYDEV_USE_BUNDLED_CMSIS EQU 1
CYDEV_VARIABLE_VDDA EQU 1
CYDEV_VDDA_MV EQU 3300
CYDEV_VDDD_MV EQU 3300
CYDEV_VDDIO_MV EQU 3300
CYDEV_WDT_GENERATE_ISR EQU 0
CydwClock_1__DIV_ID EQU 0x00000040
CydwClock_1__DIV_REGISTER EQU CYREG_PERI_DIV_16_CTL0
CydwClock_1__PA_DIV_ID EQU 0x000000FF
CYIPBLOCK_m0s8can_VERSION EQU 1
CYIPBLOCK_m0s8cpussv2_VERSION EQU 1
CYIPBLOCK_m0s8csd_VERSION EQU 1
CYIPBLOCK_m0s8ioss_VERSION EQU 1
CYIPBLOCK_m0s8lcd_VERSION EQU 2
CYIPBLOCK_m0s8lpcomp_VERSION EQU 2
CYIPBLOCK_m0s8peri_VERSION EQU 1
CYIPBLOCK_m0s8scb_VERSION EQU 2
CYIPBLOCK_m0s8srssv2_VERSION EQU 1
CYIPBLOCK_m0s8tcpwm_VERSION EQU 2
CYIPBLOCK_m0s8udbif_VERSION EQU 1
CYIPBLOCK_m0s8wco_VERSION EQU 1
CYIPBLOCK_s8pass4al_VERSION EQU 1
DMA_CHANNELS_USED__MASK EQU 0
CYDEV_BOOTLOADER_ENABLE EQU 0
    ENDIF
    END
